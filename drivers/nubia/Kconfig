## drivers/nubia/Kconfig
```kconfig
#
# Nubia drivers configuration
#

#menuconfig NUBIA_DRIVERS
menu "nubia drivers"

config NUBIA_DRIVERS
	bool "NUBIA DRIVERS"
	default n
	help
	  Say Y here if you want to enable NUBIA DRIVERS
	  If unsure, say N.

comment "Nubia Device Drivers"

if NUBIA_DRIVERS
# Add nubia drivers configuration here
source drivers/nubia/nubia_typec/Kconfig
config NUBIA_TYPEC
	bool "NUBIA TYPEC"
	default n
	help
	  set Y enabled typec driver.

#switches
config NUBIA_TOUCHSCREENS
	bool "NUBIA_TOUCHSCREENS"
	depends on NUBIA_DRIVERS
	default n
	help
	  Say Y here if you want to enable NUBIA_TOUCHSCREENS
	  If unsure, say N.
config NUBIA_NFC
	bool "NUBIA_NFC"
	default n
	help
	 Say Y here if you have enable NUBIA_NFC
	 IF  unsure ,say N
config NUBIA_FINGERPRINT
	bool "NUBIA_FINGERPRINT"
	default n
	help
	 Say Y here if you have enable NUBIA_FINGERPRINT
	 IF  unsure ,say N

config NUBIA_LEDS
	bool "NUBIA_LEDS"
	depends on NUBIA_DRIVERS
	default n
	help
	  Say Y here if you don't want to enable NUBIA_LEDS
if NUBIA_LEDS
source drivers/nubia/leds/Kconfig
endif
config NUBIA_VIBRATOR
	bool "NUBIA_VIBRATOR"
	depends on NUBIA_DRIVERS
	default n
	help
	  Say Y here if you don't want to enable NUBIA_VIBRATOR
if NUBIA_VIBRATOR
source drivers/nubia/vibrator/Kconfig
endif
config NUBIA_SENSORS
	bool "NUBIA_SENSORS"
	depends on NUBIA_DRIVERS
	default n
	help
	  Say Y here if you don't want to enable NUBIA_SENSORS
if NUBIA_SENSORS
source drivers/nubia/sensors/Kconfig
endif
endif

#source more controled by switches
if NUBIA_TOUCHSCREENS
source "drivers/nubia/touch/Kconfig"
endif

if NUBIA_NFC
source "drivers/nubia/nfc/Kconfig"
endif

if NUBIA_FINGERPRINT
source "drivers/nubia/fingerprint/Kconfig"
endif

endmenu

# Nubia configuration options

config MACH_NUBIA
    bool "NUBIA device"
    depends on ARCH_MSM
    help
      Support for Nubia products

config MACH_NUBIA_MSM8976
    bool "NUBIA MSM8976"
    depends on ARCH_MSM8916
    select MACH_NUBIA
    help
      Support for MSM8976 Nubia variants

menu "Nubia board selection"

config MACH_NUBIA_NX591J
    bool "NUBIA_NX591J board"
    select MACH_NUBIA_MSM8976
    help
      Support for Nubia Z17 Lite variant

config MACH_NUBIA_NX589J
    bool "NUBIA_NX589J board"
    select MACH_NUBIA_MSM8976
    help
      Support for Nubia Z17 Mini S variant

endmenu
```
